## yocto_training_materials/code/meta-allegion/meta-allegion/conf/distro/allegion.conf
```bitbake
# Allegion custom distribution configuration

# Build on top of poky as a base
require conf/distro/poky.conf

# Distro identity
DISTRO = "allegion"
DISTRO_NAME = "Allegion Embedded Linux"
DISTRO_VERSION = "1.0.0"
DISTRO_CODENAME = "controller"
MAINTAINER = "Allegion Embedded Team <embedded@example.com>"

# Pull in the systemd configuration fragment
require conf/distro/include/allegion-systemd.inc

# Pull in security hardening defaults
require conf/distro/include/allegion-security.inc

# --- Package format ---
# rpm is the default; ipk is lighter for embedded
PACKAGE_CLASSES ?= "package_ipk"

# --- Distro features ---
# Remove features we don't need on a headless security device
DISTRO_FEATURES:remove = "x11 wayland opengl vulkan"

# Add features we want
DISTRO_FEATURES:append = " pam seccomp"

# --- SDK information ---
SDK_VENDOR = "-allegionsdk"
SDK_VERSION = "${@d.getVar('DISTRO_VERSION').replace('snapshot-${METADATA_REVISION}', 'snapshot')}"

# --- Build provenance ---
# Record what went into every build
INHERIT += "buildhistory"
BUILDHISTORY_COMMIT = "1"

# --- Reproducibility ---
# Bake a clean version string into the image
DISTRO_VERSION[vardepsexclude] = "DATE"
```

## yocto_training_materials/code/meta-allegion/meta-allegion/conf/distro/include/allegion-security.inc
```bitbake
# Security hardening defaults for Allegion distro

# --- Compiler hardening ---
# Apply hardening flags to all compiled packages
require conf/distro/include/security_flags.inc

# --- License policy ---
# Refuse GPL-3.0 family if your product forbids it (anti-tivoization).
# Uncomment if your product policy requires it:
# INCOMPATIBLE_LICENSE = "GPL-3.0-or-later GPL-3.0-only AGPL-3.0-or-later"

# --- CVE checking ---
# Enable CVE scanning on every build (see License/SBOM/CVE study guide)
INHERIT += "cve-check"

# --- SBOM generation ---
# Generate SPDX SBOM for every image (see License/SBOM/CVE study guide)
INHERIT += "create-spdx"

# --- No empty passwords, no debug-tweaks leakage in production ---
# (debug-tweaks is controlled per-image, not here)
```

## yocto_training_materials/code/meta-allegion/meta-allegion/conf/distro/include/allegion-systemd.inc
```bitbake
# systemd init configuration for Allegion distro
#
# This is the COMPLETE, conflict-free way to enable systemd.
# Using INIT_MANAGER sets all interdependent variables correctly
# in one place, avoiding the cascade of errors that comes from
# setting DISTRO_FEATURES / VIRTUAL-RUNTIME_* manually and missing one.

# The modern one-liner (Yocto 3.1 / dunfell and later).
# Expands internally to:
#   - add "systemd" to DISTRO_FEATURES
#   - VIRTUAL-RUNTIME_init_manager = "systemd"
#   - DISTRO_FEATURES_BACKFILL_CONSIDERED += "sysvinit"
#   - VIRTUAL-RUNTIME_initscripts = ""
INIT_MANAGER = "systemd"

# Use systemd-journald for logging (no separate syslog by default).
# Set to "systemd" to also pull in a syslog-compatible path if needed.
VIRTUAL-RUNTIME_syslog ?= ""

# journald: persistent logs, capped size (see Day4.2 study guide)
# These get applied via a journald.conf we ship in the image.
```

## yocto_training_materials/code/meta-allegion/meta-allegion/conf/layer.conf
```bitbake
# Layer configuration for meta-allegion

# We have a conf and classes directory, add to BBPATH
BBPATH .= ":${LAYERDIR}"

# We have recipes-* directories, add to BBFILES
BBFILES += "${LAYERDIR}/recipes-*/*/*.bb \
            ${LAYERDIR}/recipes-*/*/*.bbappend"

BBFILE_COLLECTIONS += "allegion"
BBFILE_PATTERN_allegion = "^${LAYERDIR}/"
BBFILE_PRIORITY_allegion = "10"

# This layer supports these Yocto releases
LAYERSERIES_COMPAT_allegion = "kirkstone scarthgap"

# Layers this one depends on
LAYERDEPENDS_allegion = "core"

# Tell BitBake where machine configs live
BBFILES += "${LAYERDIR}/conf/machine/*.conf"
```

## yocto_training_materials/code/meta-allegion/meta-allegion/wic/allegion-sdimage.wks
```
# Allegion SD card / eMMC partition layout
# 4 partitions: boot, system A, system B (for A/B OTA), data
# See Image Engineering and A/B Updates study guides

# Boot: FAT32, bootloader + kernel + dtb
part /boot --source bootimg-partition --ondisk mmcblk --fstype=vfat \
    --label BOOT --active --align 4 --size 64M

# System A: the active rootfs
part / --source rootfs --ondisk mmcblk --fstype=ext4 \
    --label SYSTEM_A --align 4 --size 512M

# System B: standby for A/B updates (empty at flash time)
part --ondisk mmcblk --fstype=ext4 --label SYSTEM_B \
    --align 4 --size 512M

# Data: persistent, writable (logs, config, state)
part /data --ondisk mmcblk --fstype=ext4 --label DATA \
    --align 4 --size 512M

bootloader --ptable msdos
```

## yocto_training_materials/code/meta-allegion/meta-allegion/wic/allegion-simple.wks
```
# Simple 2-partition layout (boot + rootfs) for initial bring-up
part /boot --source bootimg-partition --ondisk mmcblk --fstype=vfat \
    --label BOOT --active --align 4 --size 64M
part / --source rootfs --ondisk mmcblk --fstype=ext4 \
    --label ROOT --align 4

bootloader --ptable msdos
```

## yocto_training_materials/code/meta-trainerdemo/conf/layer.conf
```bitbake
# Layer configuration for meta-trainerdemo
# This is the layer we build throughout the Yocto training.

# We have a conf and classes directory, add to BBPATH
BBPATH .= ":${LAYERDIR}"

# We have recipes-* directories, add to BBFILES
BBFILES += "${LAYERDIR}/recipes-*/*/*.bb \
            ${LAYERDIR}/recipes-*/*/*.bbappend"

BBFILE_COLLECTIONS += "meta-trainerdemo"
BBFILE_PATTERN_meta-trainerdemo = "^${LAYERDIR}/"
BBFILE_PRIORITY_meta-trainerdemo = "10"

# This layer is compatible with the Scarthgap (5.0) release series.
LAYERSERIES_COMPAT_meta-trainerdemo = "scarthgap"

# Tell BitBake the minimum layer dependencies (optional but good practice)
LAYERDEPENDS_meta-trainerdemo = "core"
```

## yocto_training_materials/code/wic/trainergw-ab.wks
```
# trainergw-ab.wks (D3S5)
# A/B redundant layout: two rootfs slots + a shared data partition.
# Enables atomic updates with rollback. Recommended for fielded products.

part /boot     --source bootimg-partition --ondisk mmcblk0 --fstype=vfat \
     --label boot --active --align 4 --fixed-size 64M

# Slot A (initially populated with the rootfs)
part /         --source rootfs --ondisk mmcblk0 --fstype=ext4 \
     --label rootfs_a --align 4 --fixed-size 512M

# Slot B (empty; the updater writes the new image here, then switches)
part --source empty --ondisk mmcblk0 --fstype=ext4 \
     --label rootfs_b --align 4 --fixed-size 512M

# Persistent data survives updates of either slot.
part /data     --source empty --ondisk mmcblk0 --fstype=ext4 \
     --label data --align 4 --size 256M

bootloader --ptable gpt --append="rootwait console=ttyS0,115200"
```

## yocto_training_materials/code/wic/trainergw-ro-overlay.wks
```
# trainergw-ro-overlay.wks (D3S5)
# Read-only root + writable overlay + data. Tamper-evident, fast factory reset.

part /boot     --source bootimg-partition --ondisk mmcblk0 --fstype=vfat \
     --label boot --active --align 4 --fixed-size 64M

# Read-only squashfs root (compressed, immutable).
part /         --source rootfs --ondisk mmcblk0 --fstype=squashfs \
     --label root_ro --align 4

# Writable overlay for the bits of the filesystem that must change.
part /overlay  --source empty --ondisk mmcblk0 --fstype=ext4 \
     --label overlay --align 4 --fixed-size 128M

# Application data.
part /data     --source empty --ondisk mmcblk0 --fstype=ext4 \
     --label data --align 4 --size 256M

bootloader --ptable gpt --append="rootwait console=ttyS0,115200 ro"
```

## yocto_training_materials/code/wic/trainergw-simple.wks
```
# trainergw-simple.wks (D3S4/D3S5)
# Simplest layout: one boot partition + one rootfs. No update redundancy.
# Good for bring-up and lab work; NOT recommended for fielded products.

part /boot --source bootimg-partition --ondisk mmcblk0 --fstype=vfat \
     --label boot --active --align 4 --fixed-size 64M

part /     --source rootfs --ondisk mmcblk0 --fstype=ext4 \
     --label root --align 4

bootloader --ptable msdos --append="root=/dev/mmcblk0p2 rootwait console=ttyS0,115200"
```
